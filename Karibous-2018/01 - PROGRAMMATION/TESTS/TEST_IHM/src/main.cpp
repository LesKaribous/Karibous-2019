#include <Arduino.h>
#include <U8g2lib.h>
#include <SPI.h>
#include "DFRobotDFPlayerMini.h"

#define SerialPlayer Serial1

int score = 0;
int tempsMatch = 100;
int tempsDebut= 0;

bool statutMp3 = false;

U8G2_ST7920_128X64_F_SW_SPI u8g2(U8G2_R0,13,11,12,U8X8_PIN_NONE);

#define LOGO_KARIBOUS_width 128
#define LOGO_KARIBOUS_height 33
static unsigned char LOGO_KARIBOUS_bits[] = {
   0x00, 0x00, 0x00, 0x00, 0x00, 0x00, 0x00, 0x00, 0x00, 0x00, 0x00, 0x00,
   0x00, 0x00, 0x00, 0x00, 0x00, 0x00, 0x00, 0x00, 0x00, 0x00, 0x00, 0x00,
   0x00, 0x00, 0x00, 0x00, 0x00, 0x00, 0x00, 0x00, 0x1c, 0xfc, 0xf9, 0x03,
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   0x00, 0x00, 0x00, 0x00, 0x00, 0x00, 0x00, 0x00, 0x00, 0x00, 0x00, 0x00 };


DFRobotDFPlayerMini myDFPlayer;

void u8g2_prepare(void) {
  u8g2.setFont(u8g2_font_4x6_tf);
  u8g2.setFontRefHeightExtendedText();
  u8g2.setDrawColor(1);
  u8g2.setFontPosTop();
  u8g2.setFontDirection(0);
}

void u8g2_splash_screen(void) {
  u8g2.clearBuffer();
  u8g2.drawXBMP( 0, 15, LOGO_KARIBOUS_width, LOGO_KARIBOUS_height, LOGO_KARIBOUS_bits);
  u8g2.sendBuffer();
}

void u8g2_menu_pendant_match(void) {
  u8g2.setFont(u8g2_font_inr42_mn);
  u8g2.setCursor(8, 9);
  u8g2.print(score);
  u8g2.setFont(u8g2_font_4x6_tf);
  u8g2.drawStr( 0, 0, "Score:");
  u8g2.drawStr( 70, 0, "Temps:    sec");
  u8g2.setCursor(95, 0);
  u8g2.print(tempsMatch);
  u8g2.drawStr( 105, 57, "points");
}

void u8g2_menu_avant_match(void) {
  u8g2.clearBuffer();
  u8g2_prepare();
    u8g2.setFont(u8g2_font_4x6_tf);
    u8g2.drawStr( 0, 0, "Etat MP3:");
    if ( statutMp3 )
    {
      u8g2.drawStr( 40, 0, "OK");
    }
    else
    {
      u8g2.drawStr( 40, 0, "Echec");
    }
  u8g2.sendBuffer();
}

void u8g2_splash_screen_GO(void) {
  u8g2.clearBuffer();
  u8g2.setFont(u8g2_font_logisoso58_tr);
  u8g2.drawStr( 18, 2, "GO!");
  u8g2.sendBuffer();
}


void draw(void) {
  u8g2_prepare();
  u8g2_menu_pendant_match();
}


void setup(void) {

  u8g2.begin();

  u8g2_splash_screen();

  delay (2000);
  Serial.begin(9600);
  SerialPlayer.begin(9600);

  Serial.println();
  Serial.println(F("DFRobot DFPlayer Mini Demo"));
  Serial.println(F("Initializing DFPlayer ... (May take 3~5 seconds)"));

  if (!myDFPlayer.begin(SerialPlayer)) {  //Use softwareSerial to communicate with mp3.
    Serial.println(F("Unable to begin:"));
    Serial.println(F("1.Please recheck the connection!"));
    Serial.println(F("2.Please insert the SD card!"));
    statutMp3 = false;
  }
  else{
    Serial.println(F("DFPlayer Mini online."));
    statutMp3 = true;
  }

  myDFPlayer.volume(20);  //Set volume value. From 0 to 30
  delay(1000);
  myDFPlayer.playMp3Folder(1);

  u8g2_menu_avant_match();

  delay (5000);
  u8g2_splash_screen_GO();
  delay (1000);

  tempsDebut=millis();

}

void loop(void) {
  // picture loop
  u8g2.clearBuffer();
  draw();
  u8g2.sendBuffer();
  if (tempsMatch>0)
  {
    tempsMatch = 100-((millis()-tempsDebut)/1000);
  }

  switch (tempsMatch)
  {
  case 95:
      score = 30;
      myDFPlayer.playMp3Folder(1);
    break;
  case 90:
      score = 120;
      myDFPlayer.playMp3Folder(1);
    break;
  case 85:
      score = 269;
      myDFPlayer.playMp3Folder(1);
    break;
  }


  // deley between each page
  delay(100);

}
